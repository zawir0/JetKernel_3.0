## drivers/jetmodules/Kconfig
```kconfig
menuconfig JET_MODULES
	bool "JetDroid Modules"
	default y
	---help---
	  This are various modules for the s3c6410 processor.

if JET_MODULES

source "drivers/jetmodules/g2d/Kconfig"
source "drivers/jetmodules/g3d/Kconfig"

endif # JET_MODULES
```
